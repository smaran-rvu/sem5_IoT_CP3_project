// Course: IoT and Edge Computing: Oct 2024
// This is a follow up Lab after based on the theory covered in the Session 7A about classification
// Models and the steps to make them run on ESP32

// This code is explained in the Lab8a based on the theory covered in Ses 7A
// Students are expected to identify similar datasets and port them to ESP32 based on 
// what is learnt here. Sample Examples are: IRIS dataset, Cactus, etc. as part of CP3 Project
// evaluation component.
// For other datasets that can be classified and ported on to ESP32
// Ref:https://archive.ics.uci.edu/datasets 

#include <EloquentTinyML.h>
// This file has the TFlite model generated by the Cars_Classify_Tflite_hex.ipynb 
// Done on Sep 2024
#include "ultasonic_flow_model_esp32.h"


#define NUMBER_OF_INPUTS 27
#define NUMBER_OF_OUTPUTS 4 
// in future projects you may need to tweek this value: it's a trial and error process
//#define TENSOR_ARENA_SIZE 3*1024  // Since the size is 2960 here, this needs to be 
// changed from 2*1024 to 3*1024

#define TENSOR_ARENA_SIZE 5*1024  // Since the size is 3836 for more improved Sine model

Eloquent::TinyML::TfLite<NUMBER_OF_INPUTS, NUMBER_OF_OUTPUTS, TENSOR_ARENA_SIZE> ml;

void setup() {
    Serial.begin(115200);
   
    ml.begin(ultasonic_flow_model_esp32);
}

float fResult[NUMBER_OF_OUTPUTS] = {0};
float fRes = NULL;

int find_class(float *arr){
  int max = 0, pred_class = 0;

  if (arr[0] > max)
    pred_class = 1;
  if (arr[1] > max)
    pred_class = 2;
  if (arr[2] > max)
    pred_class = 3;
  if (arr[3] > max)
    pred_class = 4;
  
  return pred_class;
}

void loop() {

    // Line no. 19: Input1
    float input1[] = {0.42486196756362915f,
                      0.792097806930542f,
                      0.5861948728561401f,
                      0.5610111951828003f,
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                      0.006507592275738716f,
                      0.006507592275738716f
    };
    // Expected output1: 1.0 0.0 0.0 0.0

    // Line no. 109: Input2
    float input2[] = {0.4233745038509369f,
                      0.791832447052002f,
                      0.5857370495796204f,
                      0.9354183077812195f,
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                      0.006507592275738716f,
                      0.006507592275738716f
    };
    // Expected output2: 0.0 0.0 1.0 0.0

    float input3[] ={0.3357534408569336f,
                     0.7899659276008606f,
                     0.8327049016952515f,
                     0.2211623638868332f,
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                     0.989154040813446f,
                     0.989154040813446f
      };
    // Expected output2: 0.0 0.0 0.0 1.0

    

    initfResult(fResult);
    fRes = ml.predict(input1, fResult);
    Serial.print("\nThe output value returned for input1 is:\n");
    // Serial.println(fRes);
    displayOutput(fResult);  
    Serial.print("\nPredicted Class: ");
    Serial.println(find_class(fResult));

    initfResult(fResult);
    fRes = ml.predict(input2, fResult);
    Serial.print("\nThe output value returned for input2 is:\n");
    // Serial.println(fRes);
    displayOutput(fResult);
    Serial.print("\nPredicted Class: ");
    Serial.println(find_class(fResult));

    initfResult(fResult);
    fRes = ml.predict(input3, fResult);
    Serial.print("\nThe output value returned for input3 is:\n");
    // Serial.println(fRes);
    displayOutput(fResult);     
    Serial.print("\nPredicted Class: ");
    Serial.println(find_class(fResult));

    delay(5000); // 5 milliseconds of delay between two plots
}

void initfResult(float *fResult){
  
    for(int i = 0; i < NUMBER_OF_OUTPUTS; i++){
       fResult[i] = 0.0f;
    }
} // end of displayOutput()

void displayOutput(float *fResult){
  
    for(int i = 0; i < NUMBER_OF_OUTPUTS; i++){
        Serial.print(fResult[i]);
        Serial.print(" ");
    }
} // end of displayOutput()
